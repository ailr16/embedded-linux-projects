## conf/bblayers.conf
```bitbake
# POKY_BBLAYERS_CONF_VERSION is increased each time build/conf/bblayers.conf
# changes incompatibly
POKY_BBLAYERS_CONF_VERSION = "2"

BBPATH = "${TOPDIR}"
BBFILES ?= ""

BBLAYERS ?= " \
  /home/yocto-user/yocto/poky/meta \
  /home/yocto-user/yocto/poky/meta-poky \
  /home/yocto-user/yocto/poky/meta-yocto-bsp \
  /home/yocto-user/yocto/meta-openembedded/meta-oe \
  /home/yocto-user/yocto/meta-raspberrypi \
  "
```

## yocto/conf/bblayers.conf
```bitbake
# POKY_BBLAYERS_CONF_VERSION is increased each time build/conf/bblayers.conf
# changes incompatibly
POKY_BBLAYERS_CONF_VERSION = "2"

BBPATH = "${TOPDIR}"
BBFILES ?= ""

BBLAYERS ?= " \
  /home/ailr16/yocto/poky/meta \
  /home/ailr16/yocto/poky/meta-poky \
  /home/ailr16/yocto/poky/meta-yocto-bsp \
  /home/ailr16/yocto/meta-openembedded/meta-oe \
  /home/ailr16/yocto/meta-raspberrypi \
  "
```
